## main/Kconfig.projbuild
```kconfig
menu "Agriculture Controller Configuration"

    config AGRI_MASTER_PIN
        string "PIN for MASTER registration SMS command"
        default "1234"
        help
            Any phone can claim the master (authorized) number by sending
            "MASTER <pin>". Change this before deploying.

    config AGRI_DEFAULT_MOISTURE_THRESHOLD
        int "Default soil moisture threshold (percent)"
        range 5 95
        default 30
        help
            In AUTO mode the pump starts below this moisture level and stops
            at threshold + hysteresis. Can be changed later by SMS (THRESH n)
            and is persisted in NVS.

    config AGRI_MOISTURE_HYSTERESIS
        int "Moisture hysteresis (percent)"
        range 1 30
        default 5

    config AGRI_PUMP_MAX_RUNTIME_S
        int "Pump safety max runtime (seconds)"
        range 10 7200
        default 300
        help
            Hard safety limit: the pump is switched OFF after this time no
            matter what, to prevent flooding / dry-run damage.

    config AGRI_PUMP_MIN_CYCLE_S
        int "Minimum time between two pump starts (seconds)"
        range 0 86400
        default 600

    config AGRI_SMS_POLL_INTERVAL_S
        int "SMS inbox poll interval (seconds)"
        range 5 300
        default 15

    config AGRI_SENSOR_PERIOD_S
        int "Sensor sampling period (seconds)"
        range 2 600
        default 10

endmenu
```

## sdkconfig.defaults
```kconfig
# Target chip (allows `idf.py build` without `idf.py set-target` first — used by CI)
CONFIG_IDF_TARGET="esp32"

# Flash: KC868-A2 ships with 4MB
CONFIG_ESPTOOLPY_FLASHSIZE_4MB=y
CONFIG_ESPTOOLPY_FLASHSIZE="4MB"

# Partition table: custom single factory app
CONFIG_PARTITION_TABLE_CUSTOM=y
CONFIG_PARTITION_TABLE_CUSTOM_FILENAME="partitions.csv"
CONFIG_PARTITION_TABLE_FILENAME="partitions.csv"

# Serial flasher / monitor
CONFIG_ESPTOOLPY_FLASHMODE_QIO=y
CONFIG_ESPTOOLPY_FLASHFREQ_40M=y
CONFIG_ESPTOOLPY_BAUD_460800=y
CONFIG_MONITOR_BAUD_115200=y

# FreeRTOS tick for decent timing resolution
CONFIG_FREERTOS_HZ_1000=y
CONFIG_FREERTOS_HZ=1000

# Compiler: useful warnings
CONFIG_COMPILER_WARN_WRITE_STRINGS=y

# Keep log level Info on UART0 console
CONFIG_LOG_DEFAULT_LEVEL_INFO=y
```
